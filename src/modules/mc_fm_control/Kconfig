## src/modules/mc_fm_control/Kconfig
```kconfig
menuconfig MODULES_MC_FM_CONTROL
	bool "mc_fm_control"
	default n
	---help---
		Enable support for mc_fm_control

menuconfig USER_MC_FM_CONTROL
	bool "mc_fm_control running as userspace module"
	default y
	depends on BOARD_PROTECTED && MODULES_MC_FM_CONTROL
	---help---
		Put mc_fm_control in userspace memory
```

## src/modules/mc_mpc_control/Kconfig
```kconfig
menuconfig MODULES_MC_MPC_CONTROL
	bool "mc_mpc_control"
	default n
	---help---
		Enable support for mc_mpc_control

menuconfig USER_MC_MPC_CONTROL
	bool "mc_mpc_control running as userspace module"
	default y
	depends on BOARD_PROTECTED && MODULES_MC_MPC_CONTROL
	---help---
		Put mc_mpc_control in userspace memory
```

## src/modules/mc_tm_control/Kconfig
```kconfig
menuconfig MODULES_MC_TM_CONTROL
	bool "mc_tm_control"
	default n
	---help---
		Enable support for mc_tm_control

menuconfig USER_MC_TM_CONTROL
	bool "mc_tm_control running as userspace module"
	default y
	depends on BOARD_PROTECTED && MODULES_MC_TM_CONTROL
	---help---
		Put mc_tm_control in userspace memory
```
